## build-dir/conf/bblayers.conf
```bitbake
# POKY_BBLAYERS_CONF_VERSION is increased each time build/conf/bblayers.conf
# changes incompatibly
POKY_BBLAYERS_CONF_VERSION = "2"

BBPATH = "${TOPDIR}"
BBFILES ?= ""

BBLAYERS ?= " \
  /home/vijay/yocto/poky/meta \
  /home/vijay/yocto/poky/meta-poky \
  /home/vijay/yocto/poky/meta-yocto-bsp \
  /home/vijay/yocto/YoctoProject/meta-mylayer \
  "
```
